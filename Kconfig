## Kconfig
```kconfig
menu "Sofle custom features"

config SOFLE_BONGO_DISPLAY
    bool "Landscape Bongo Cat OLED status screen"
    depends on ZMK_DISPLAY
    select LV_USE_IMG
    help
      Replaces the normal status screen with a 128x32 landscape Bongo Cat.

endmenu
```
